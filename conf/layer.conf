## conf/layer.conf
```bitbake
# We have a conf and classes directory, add to BBPATH
BBPATH .= ":${LAYERDIR}"

# We have recipes-* directories, add to BBFILES
BBFILES += "${LAYERDIR}/recipes-*/*/*.bb \
            ${LAYERDIR}/recipes-*/*/*.bbappend"

BBFILE_COLLECTIONS += "meta-custom-demo"
BBFILE_PATTERN_meta-custom-demo = "^${LAYERDIR}/"
BBFILE_PRIORITY_meta-custom-demo = "6"

LAYERDEPENDS_meta-custom-demo = "core"
LAYERSERIES_COMPAT_meta-custom-demo = "scarthgap"
```
